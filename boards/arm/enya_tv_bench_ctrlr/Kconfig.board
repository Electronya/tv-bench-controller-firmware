## boards/arm/enya_tv_bench_ctrlr/Kconfig.board
```kconfig
# Electronya TV Bench Controller board configuration

# Copyright (c) 2018 Electronya

config BOARD_ENYA_TV_BENCH_CTRLR
	bool "Electronya TV Bench Controller"
	depends on SOC_STM32F070XB
```

## boards/arm/enya_tv_bench_ctrlr/Kconfig.defconfig
```kconfig
# Electronya TV Bench Controller board configuration

# Copyright (c) 2018 Electronya

if BOARD_ENYA_TV_BENCH_CTRLR

config BOARD
	default "enya_tv_bench_ctrlr"

config SPI_STM32_INTERRUPT
	default y
	depends on SPI

endif # BOARD_ENYA_TV_BENCH_CTRLR
```

## boards/arm/enya_tv_bench_ctrlr/enya_tv_bench_ctrlr_defconfig
```kconfig
# Zephyr Kernel Configuration
CONFIG_SOC_SERIES_STM32F0X=y
CONFIG_HEAP_MEM_POOL_SIZE=256

# Platform Configuration
CONFIG_SOC_STM32F070XB=y

# Serial Drivers
CONFIG_SERIAL=y
CONFIG_UART_INTERRUPT_DRIVEN=y
# enable console
CONFIG_CONSOLE=y
CONFIG_UART_CONSOLE=y

# GPIO Controller
CONFIG_GPIO=y

# Counter Driver
CONFIG_COUNTER=y
CONFIG_COUNTER_TIMER_STM32=y

# Enable clocks
CONFIG_CLOCK_CONTROL=y

# enable pin controller
CONFIG_PINCTRL=y

# Electronya wrapper
CONFIG_ENYA_ZEPHYR_WRAPPER=y
CONFIG_ENYA_GPIO=y
CONFIG_ENYA_COUNTER=y
CONFIG_ENYA_LED_STRIP=y
```

## testcase.yaml
```yaml
tests:
  tv_bench_ctlr_coprocessor.dummy:
    platform_allow: qemu_cortex_m3
    tags: dummy
    extra_args: BUILD_ENV=test TEST_SUITE=dummy
    extra_configs:
      - CONFIG_ZTEST=y
```

## tests/unit/testcase.yaml
```yaml
tests:
  tv_bench_ctlr_coprocessor.appMsg:
    platform_allow: qemu_cortex_m0
    tags: appMsg
    extra_args: TEST_SUITE=appMsg
    extra_configs:
      - CONFIG_ZTEST=y
      - CONFIG_ZTEST_NEW_API=y
      - CONFIG_LED_STRIP=y
      - CONFIG_ENYA_ZEPHYR_WRAPPER=y
      - CONFIG_ENYA_LED_STRIP=y
  tv_bench_ctlr_coprocessor.colorMngr:
    platform_allow: qemu_cortex_m0
    tags: colorMngr
    extra_args: TEST_SUITE=colorMngr
    extra_configs:
      - CONFIG_ZTEST=y
      - CONFIG_ZTEST_NEW_API=y
      - CONFIG_LED_STRIP=y
      - CONFIG_ENYA_ZEPHYR_WRAPPER=y
      - CONFIG_ENYA_LED_STRIP=y
      - CONFIG_HEAP_MEM_POOL_SIZE=256
  tv_bench_ctlr_coprocessor.sequenceMngr:
    platform_allow: qemu_cortex_m0
    tags: sequenceMngr
    extra_args: TEST_SUITE=sequenceMngr
    extra_configs:
      - CONFIG_ZTEST=y
      - CONFIG_ZTEST_NEW_API=y
      - CONFIG_LED_STRIP=y
      - CONFIG_ENYA_ZEPHYR_WRAPPER=y
      - CONFIG_ENYA_LED_STRIP=y
      - CONFIG_HEAP_MEM_POOL_SIZE=256
  tv_bench_ctlr_coprocessor.ledMngr:
    platform_allow: qemu_cortex_m0
    tags: ledMngr
    extra_args: TEST_SUITE=ledMngr
    extra_configs:
      - CONFIG_ZTEST=y
      - CONFIG_ZTEST_NEW_API=y
      - CONFIG_LED_STRIP=y
      - CONFIG_ENYA_ZEPHYR_WRAPPER=y
      - CONFIG_ENYA_LED_STRIP=y
  tv_bench_ctlr_coprocessor.seqCmd:
    platform_allow: qemu_cortex_m0
    tags: seqCmd
    extra_args: TEST_SUITE=seqCmd
    extra_configs:
      - CONFIG_ZTEST=y
      - CONFIG_ZTEST_NEW_API=y
      - CONFIG_LED_STRIP=y
      - CONFIG_ENYA_ZEPHYR_WRAPPER=y
      - CONFIG_ENYA_LED_STRIP=y
```
